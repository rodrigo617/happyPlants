/**
   SKETCH PARA ENVIAR SMS CON ARDUINO UTILIZANDO LA LIBRERIA DE ADAFRUIT FONA.
   ESTE SKETCH SIMULA UNA ALARMA EN LA CUAL AL OPRIMIR UN BOTON SE ENVIA UN MENSAJE SMS
   ALERTANDO DE UNA INTRUSION.
*/
#include <SoftwareSerial.h>
#include "Adafruit_FONA.h"
// CONFIGURACION DE UART GSM
#define CONFIG_GSM_RXPIN 4
#define CONFIG_GSM_TXPIN 3
#define CONFIG_GSM_BAUDRATE 9600
// CONFIGURACION DEL NUMERO DESTINO DEL MENSAJE SMS
#define CONFIG_GSM_SMS_DESTINATION "+52155XXXXXXXX"
// PIN UTILIZADO COMO ENTRADA PARA DESENCADENAR EL ENVIO DE UN MENSAJE
#define CONFIG_ALARM_PIN 5
// PUERTO SERIE EMULADO: EL ARDUINO UNO TIENE SOLO 1 UART
// EN EL CONSTRUCTOR DE SOFTWARESERIAL SE ESPECIFICAN LOS PINES PARA RX Y TX
SoftwareSerial swseri = SoftwareSerial(CONFIG_GSM_RXPIN, CONFIG_GSM_TXPIN);
// OBJETO ADAFRUIT_FONA USADO PARA COMUNICARSE CON EL SIM800L
Adafruit_FONA fona = Adafruit_FONA(10);
void setup() {
  // PREPARAR PINES IO
  pinMode(CONFIG_ALARM_PIN, INPUT_PULLUP);
  // PREPARAR LOS PUERTOS SERIALES A LA VELOCIDAD CONFIGURADA
  swseri.begin(CONFIG_GSM_BAUDRATE);
  Serial.begin(CONFIG_GSM_BAUDRATE);
  // IMPRIMIR EL ENCABEZADO INCIAL
  Serial.println(F("----------------------------------------------------"));
  Serial.println(F("    EJEMPLO ALARMA CONTRA INTRUSOS CON ALERTA SMS   "));
  Serial.println(F("            https://www.geekfactory.mx              "));
  Serial.println(F("----------------------------------------------------"));
  // INICIAR LA COMUNICACION CON EL MODULO GSM
  // PASAMOS REFERENCIA AL PUERTO SERIE USADO PARA LA COMUNICACION CON EL MODEM
  if (fona.begin(swseri))
    Serial.println(F("MODULO GSM OK"));
  else
  {
    // BLOQUEAR LA EJECUCIÓN EN ESTE PUNTO SI NO SE ENCUENTRA MODULO GSM O FALLA LA COMUNICACIÓN CON ESTE
    Serial.println(F("NO SE ENCUENTRA MODULO GSM"));
    while (1);
  }
  // AQUI SE REALIZA EL ENVIO DEL MENSAJE SMS
  // INDICAMOS EL NUMERO DESTINO Y EL CUERPO DEL MENSAJE
  if (!fona.sendSMS(CONFIG_GSM_SMS_DESTINATION, "Alarma SMS encendiendo!!!")) {
    Serial.println(F("ERROR"));
  } else {
    Serial.println(F("ENVIADO"));
  }
}
void loop() {
  // ESPERAR CAMBIO DE ESTADO EN EL PIN
  if (!digitalRead(CONFIG_ALARM_PIN))
  {
    // RETARDO PARA LIDIAR CON REBOTES Y RUIDO
    delay(100);
    // VOLVEMOS A REVISAR EL ESTADO DEL PIN
    if (!digitalRead(CONFIG_ALARM_PIN))
    {
      if (!fona.sendSMS(CONFIG_GSM_SMS_DESTINATION, "MENSAJE DE ALERTA DEL SISTEMA DE ALARMA DOMESTICA!!!")) {
        Serial.println(F("ERROR AL ENVIAR MENSAJE DE ALARMA"));
      } else {
        Serial.println(F("MENSAJE DE ALARMA ENVIADO"));
      }
      // PARA NO ENVIAR DEMASIADOS MENSAJES SEGUIDOS
      delay(5000);
    }
  }
}
